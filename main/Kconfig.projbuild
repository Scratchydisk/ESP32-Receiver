## main/Kconfig.projbuild
```kconfig
menu "BT Receiver Configuration"

    choice A2DP_SINK_OUTPUT
        prompt "A2DP Sink Output"
        default A2DP_SINK_OUTPUT_EXTERNAL_I2S
        help
            Select to use Internal DAC or external I2S/PCM driver

        config A2DP_SINK_OUTPUT_INTERNAL_DAC
            bool "Internal DAC"
            help
                Select this to use Internal DAC sink output

        config A2DP_SINK_OUTPUT_EXTERNAL_I2S
            bool "External I2S Codec"
            help
                Select this to use External I2S sink output

        config A2DP_SINK_OUTPUT_EXTERNAL_PCM
            bool "External PCM Codec"
            help
                Select this to use External PCM sink output
    endchoice

    config DISCOVERY_MODE_ENABLE_GPIO
        int "Discovery Mode Enable GPIO"
        default 17
        help 
            Pulling this pin low will put the device into Bluetooth 
            discovery mode.

    config DISCOVERY_MODE_DURATION
        int "Discovery Mode Duration (seconds)"
        default 60
        help 
            Length of time the device remains in discovery mode after
            the user enables it.

    config DEVICE_NAME
        string "Bluetooth Device Name"
        default "Grotsoft_Receiver"
        help 
            Discoverable device name for this Bluetooth
            receiver.

    config DISPLAY_I2C_SCL_GPIO
        int "Display SCL GPIO"
        default 23
        help
            I2C SCL GPIO number for OLED display.

    config DISPLAY_I2C_SDA_GPIO
        int "Display SDA GPIO"
        default 21
        help
            I2C SDA GPIO number for OLED display.

    config DISPLAY_I2C_ADDRESS
        hex "Display's I2C Address"
        default 0x78
        help
            Hex vaule of display's I2C address

    config I2S_LRCK_GPIO
        int "I2S LRCK (WS) GPIO"
        default 22
        depends on A2DP_SINK_OUTPUT_EXTERNAL_I2S
        help
            GPIO number to use for I2S LRCK(WS) Driver.

    config I2S_BCK_GPIO
        int "I2S BCK GPIO"
        default 26
        depends on A2DP_SINK_OUTPUT_EXTERNAL_I2S
        help
            GPIO number to use for I2S BCK Driver.

    config I2S_DATA_GPIO
        int "I2S DATA GPIO"
        default 25
        depends on A2DP_SINK_OUTPUT_EXTERNAL_I2S
        help
            GPIO number to use for I2S Data Driver.

endmenu
```
